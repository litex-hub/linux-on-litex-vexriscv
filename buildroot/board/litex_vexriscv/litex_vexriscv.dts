/include/ "litex-vexriscv-linux.dtsi"

/ {
	compatible = "enjoy-digital,litex-vexriscv-soclinux";
	model = "VexRiscv SoCLinux Generic Board";

	chosen {
		bootargs = "mem=32M@0x40000000 rootwait console=hvc0 root=/dev/ram0 init=/sbin/init swiotlb=32";
		linux,initrd-start = <0xC0800000>;
		linux,initrd-end   = <0xC1000000>; // max 8MB ramdisk image
	};

	cpus {
		timebase-frequency = <50000000>;
	};

	memory@c0000000 {
		device_type = "memory";
		reg = <0x0 0xc0000000 0x1 0x02000000>;
	};
};
